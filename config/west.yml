## config/west.yml
```yaml
manifest:
  defaults:
    remote: urob
    #revision: v0.1 # Pin everything to v0.1
    revision: main

  remotes:
    - name: zmkfirmware
      url-base: https://github.com/zmkfirmware
    - name: urob
      url-base: https://github.com/urob

  projects:
    # This is vanilla ZMK - just using my remote to pin the current state of main,
    # as upstream hasn't yet released a version with mouse.
    - name: zmk
      remote: zmkfirmware
        # revision: v0.1+mouse
      #revision: 4dfc45d4ab38c23cae61dae4699bd0fbef4e33eb
      import: app/west.yml

    # ZMK modules
    - name: zmk-adaptive-key
      path: modules/zmk/adaptive-key
    - name: zmk-auto-layer
      path: modules/zmk/auto-layer
    - name: zmk-helpers
      path: modules/zmk/helpers
    - name: zmk-leader-key
      revision: v0.1+locality
      path: modules/zmk/leader-key
    - name: zmk-tri-state
      path: modules/zmk/tri-state
      


  self:
    path: config
```
